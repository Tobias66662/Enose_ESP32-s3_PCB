## sdkconfig.defaults
```kconfig
# Use native USB Serial/JTAG as the main console
CONFIG_ESP_CONSOLE_UART_NONE=y
CONFIG_ESP_CONSOLE_USB_SERIAL_JTAG=y
# CONFIG_ESP_CONSOLE_USB_CDC is not set
CONFIG_ESP_CONSOLE_SECONDARY_NONE=y

# Flash: 8MB (N8 in N8R8)
CONFIG_ESPTOOLPY_FLASHSIZE_8MB=y

# PSRAM: 8MB Octal SPI (R8 in N8R8)
CONFIG_SPIRAM=y
CONFIG_SPIRAM_MODE_OCT=y
CONFIG_SPIRAM_SPEED_80M=y
CONFIG_SPIRAM_BOOT_INIT=y

CONFIG_SUPPORT_TERMIOS=y
CONFIG_COMPILER_ASSERT_NDEBUG_EVALUATE=y
CONFIG_COMPILER_DISABLE_DEFAULT_ERRORS=y
# CONFIG_COMPILER_ORPHAN_SECTIONS_ERROR is not set
CONFIG_COMPILER_ORPHAN_SECTIONS_WARNING=y
CONFIG_HTTPD_MAX_REQ_HDR_LEN=512

CONFIG_FATFS_LFN_NONE=y
# CONFIG_FATFS_LFN_HEAP is not set

# CONFIG_MBEDTLS_THREADING_C is not set
# CONFIG_MBEDTLS_THREADING_ALT is not set

CONFIG_MBEDTLS_SSL_KEEP_PEER_CERTIFICATE=y
CONFIG_ESP_PROTOCOMM_SUPPORT_SECURITY_VERSION_0=y
CONFIG_ESP_PROTOCOMM_SUPPORT_SECURITY_VERSION_1=y

# CONFIG_MBEDTLS_LARGE_KEY_SOFTWARE_MPI is not set
```
